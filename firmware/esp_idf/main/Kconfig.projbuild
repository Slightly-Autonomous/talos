## firmware/esp_idf/main/Kconfig.projbuild
```kconfig
menu "Talos node"

choice TALOS_BOARD
    prompt "Board"
    default TALOS_BOARD_TL_SN_002
    help
        Which board table (BoardSupport) the firmware runs on. TL-SN-002 is the
        self-contained node (ADR 0019). The four-slot TL-SN-001 hardware is
        archived (hardware/archive/modular-2026-11); its board table stays
        only as a host-test fixture for the slot code paths.

config TALOS_BOARD_TL_SN_002
    bool "TL-SN-002 self-contained sensor node (ADR 0019)"

endchoice

endmenu
```
